## prj.conf
```kconfig
CONFIG_GPIO=y
CONFIG_LOG=y
CONFIG_SERIAL=y
CONFIG_CONSOLE=y
CONFIG_UART_CONSOLE=y
CONFIG_PRINTK=y
```

## boards/nrf5340dk_nrf5340_cpuapp.overlay
```dts
/*
 * Devicetree overlay for nRF5340 DK
 * Add your peripheral and pin configurations here.
 * See: https://docs.zephyrproject.org/latest/build/dts/howtos.html
 */
```

## src/main.c
```c
#include <zephyr/kernel.h>
#include <zephyr/logging/log.h>

LOG_MODULE_REGISTER(main, LOG_LEVEL_INF);

int main(void)
{
	LOG_INF("Application started");

	while (1) {
		k_msleep(1000);
	}

	return 0;
}
```
